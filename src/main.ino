/* ------------- Tanaclocki -------------*/
/* This is a wifi clock that I originally
made for a friend using an ESP8266 and an
SSD1306. Wifi Manager is included for easy
internet access as well as a web server for
setting the timezone. */


#include <Arduino.h>
#include <U8g2lib.h>
#include <ESP8266WiFi.h>
#include <WiFiUdp.h>
#include <DNSServer.h>
#include <ESP8266WebServer.h>
#include <WiFiManager.h>
#include <WiFiClient.h>
#include <ESP8266WebServer.h>
#include <EEPROM.h>

//#include <NTPClient.h>
#include <NTPtimeESP.h>

const char INDEX_HTML[] =
"<!DOCTYPE HTML>"
"<html>"
"<head>"
"<meta name = \"viewport\" content = \"width = device-width, initial-scale = 1.0, maximum-scale = 1.0, user-scalable=0\">"
"<title>Clock Timezone</title>"
"<style>"
"\"body { background-color: #808080; font-family: Arial, Helvetica, Sans-Serif; Color: #000000; }\""
"</style>"
"</head>"
"<body>"
"<FORM action=\"/\" method=\"post\">"
"Does your country use DST? <INPUT type=\"radio\" name=\"DST\" value=\"2\">Yes <INPUT type=\"radio\" name=\"DST\" value=\"0\">No<BR>"
"</P>"
"<P>"
"Set UTC/GMT offset: <input type=\"text\" name=\"TZ\">"
"</P>"
"<P>"
"Set girl: <input type=\"text\" name=\"GIRL\">"
"</P>"
"<P>"
"Click this after setting all values: <INPUT type=\"submit\" value=\"Set\">"
"</P>"
"</FORM>"
"</body>"
"</html>";

const unsigned char testArray[][512] PROGMEM = {
  // Asuka
  { 0x00, 0x00, 0x00, 0x20, 0x00, 0x80, 0x00, 0x00, 0x00, 0x00, 0x00, 0x18,
  0x00, 0x00, 0x03, 0x00, 0x00, 0x00, 0x00, 0x04, 0x00, 0x00, 0x0c, 0x00,
  0x00, 0x00, 0x00, 0x03, 0x00, 0x00, 0x30, 0x00, 0x00, 0x00, 0x80, 0x00,
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  0xf0, 0x23, 0x00, 0x00, 0x00, 0x00, 0x00, 0x00 },
  // Miku
  { 0x00, 0x00, 0x00, 0x00, 0x00, 0xC0, 0x00, 0x00, 0x00, 0x00, 0x00, 0x00,
  0x00, 0x30, 0x01, 0x00, 0x00, 0x00, 0x00, 0x00, 0x00, 0x88, 0x02, 0x00,
  0x00, 0x06, 0x00, 0xF0, 0x1F, 0x84, 0x05, 0x00, 0x00, 0x09, 0x80, 0x0F,
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  0x5B, 0x00, 0xA4, 0xFF, 0x79, 0x9F, 0x00, 0x7D },
  // Momiji
  { 0x00, 0x00, 0x00, 0x00, 0x00, 0x00, 0x00, 0x00, 0x00, 0x00, 0xc0, 0xff,
  0x3f, 0x00, 0x00, 0x00, 0x00, 0x00, 0x38, 0x00, 0xc0, 0x01, 0x00, 0x00,
  0x00, 0x00, 0x06, 0x00, 0x00, 0x06, 0x00, 0x00, 0x00, 0x80, 0xc1, 0xff,
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  0x00, 0xf2, 0xff, 0xe7, 0xff, 0xff, 0xff, 0x04 }
};

// A UDP instance to let us send and receive packets over UDP
//WiFiUDP udp;
WiFiUDP ntpUDP;
// NTPClient timeClient(ntpUDP);

NTPtime NTPch("time.nist.gov");
strDateTime dateTime;

U8G2_SSD1306_128X64_NONAME_1_SW_I2C u8g2(U8G2_R0, D3, D2, U8X8_PIN_NONE);
//IPAddress timeServerIP; // time.nist.gov NTP server address
ESP8266WebServer server(80);

//unsigned int localPort = 2390;      // local port to listen for UDP packets
//const char* ntpServerName = "time.nist.gov";
//const int NTP_PACKET_SIZE = 48; // NTP time stamp is in the first 48 bytes of the message
//byte packetBuffer[NTP_PACKET_SIZE]; //buffer to hold incoming and outgoing packets
byte hPic = 64;
byte hText = 5;
int gmtOffset = -8;
byte version = 1;
byte dstState = 2;
byte girl = 2;

void handleRoot(){
  if (server.hasArg("TZ") || server.hasArg("GIRL") || server.hasArg("DST")) handleSubmit();
  else server.send(200, "text/html", INDEX_HTML);
}

void returnFail(String msg){
  server.sendHeader("Connection", "close");
  server.sendHeader("Access-Control-Allow-Origin", "*");
  server.send(500, "text/plain", msg + "\r\n");
}

void handleSubmit(){
  String formData;
  String dstData;
  String girlData;

  // if (!server.hasArg("TZ") || !server.hasArg("DST") || !server.hasArg("GIRL")) return returnFail("BAD ARGS");
  if (server.hasArg("TZ")){
    formData = server.arg("TZ");
    gmtOffset = formData.toInt();
    EEPROM.write(0, gmtOffset + 11);
    Serial.print("Wrote GMT ");
    Serial.print(EEPROM.read(0) - 11);
    Serial.println(" to EEPROM.");
  }
  if (server.hasArg("DST")){
    dstData = server.arg("DST");
    dstState = dstData.toInt();
    EEPROM.write(2, dstState);
    Serial.print("Wrote DST state ");
    Serial.print(EEPROM.read(2));
    Serial.println(" to EEPROM.");
  }
  if (server.hasArg("GIRL")){
    girlData = server.arg("GIRL");
    girl = girlData.toInt();
    EEPROM.write(3, girl);
    Serial.print("Wrote girl ");
    Serial.print(EEPROM.read(3));
    Serial.println(" to EEPROM.");
  }
  EEPROM.commit();

  server.send(200, "text/html", INDEX_HTML);
}

void returnOK(){
  server.sendHeader("Connection", "close");
  server.sendHeader("Access-Control-Allow-Origin", "*");
  server.send(200, "text/plain", "OK\r\n");
}

void handleNotFound(){
  String message = "File Not Found\n\n";
  message += "URI: ";
  message += server.uri();
  message += "\nMethod: ";
  message += (server.method() == HTTP_GET)?"GET":"POST";
  message += "\nArguments: ";
  message += server.args();
  message += "\n";
  for (uint8_t i=0; i<server.args(); i++){
    message += " " + server.argName(i) + ": " + server.arg(i) + "\n";
  }
  server.send(404, "text/plain", message);
}

void setup(void) {
  EEPROM.begin(2);
  pinMode(D4, OUTPUT);
  digitalWrite(D4, HIGH);
  //u8g2_SetI2CAddress(u8g2.getU8g2(), 0x78);

  u8g2.begin();
  u8g2.enableUTF8Print();		// enable UTF8 support for the Arduino print() function

  u8g2.setFont(u8g2_font_b10_t_japanese1);  // all the glyphs of "こんにちは世界" are already included in japanese1: Lerning Level 1-6
  u8g2.setFontDirection(0);
  u8g2.firstPage();
  do {

    u8g2.setCursor(15, 15);
    u8g2.print("Connecting...");

  } while ( u8g2.nextPage() );

  /* Time keeping */
  Serial.begin(115200);
  Serial.println();
  Serial.println();

  if (EEPROM.read(1) != version) {
    EEPROM.write(0, gmtOffset + 11);
    EEPROM.write(1, version);
    EEPROM.commit();
  }
  else {
    gmtOffset = EEPROM.read(0) - 11;
    dstState = EEPROM.read(2);
    girl = EEPROM.read(3);
  }

  WiFiManager wifiManager;
  // wifiManager.resetSettings(); // Reset network and credentials, used for testing

  wifiManager.autoConnect("AutoConnectAP", "waifuclock");

  Serial.println("WiFi connected");
  Serial.println("IP address: ");
  Serial.println(WiFi.localIP());

  /*

  Serial.println("Starting UDP");
  udp.begin(localPort);
  Serial.print("Local port: ");
  Serial.println(udp.localPort());

  */

  //timeClient.begin();

  server.on("/", handleRoot);
  server.onNotFound(handleNotFound);
  server.begin();

  u8g2.setFont(u8g2_font_b10_t_japanese1);  // all the glyphs of "こんにちは世界" are already included in japanese1: Lerning Level 1-6
  u8g2.setFontDirection(0);
  u8g2.firstPage();
  do {

    u8g2.setCursor(15, 15);
    u8g2.print("Local IP:");
    u8g2.setCursor(15, 30);
    u8g2.print(WiFi.localIP());

  } while ( u8g2.nextPage() );
  delay(1000);
}


unsigned long previousMillis;
byte blink = 0;

void loop(){

  //timeClient.update();

  dateTime = NTPch.getNTPtime(gmtOffset,dstState);


  server.handleClient();

  if ((millis() - previousMillis) > 1000){

  blink++; if (blink > 1) blink = 0;

  if(dateTime.valid) NTPch.printDateTime(dateTime);

  //int hour = timeClient.getHours();
  //int minutes = timeClient.getMinutes();


  u8g2.setFont(u8g2_font_b10_t_japanese1);
  u8g2.setFontDirection(0);
  u8g2.firstPage();
  do {

    int hour = dateTime.hour;
    int minutes = dateTime.minute;

    u8g2.drawXBMP(hPic, 0, 64, 64, testArray[girl]);

    bool PM = 0;
    //hour+=gmtOffset;
    //if (hour < 1) hour+=24;
    //if (hour > 24) hour-=24;

    u8g2.setCursor(hText, 15);
    if ((hour >= 6) && (hour < 12)) u8g2.print("おはよう");		   // morning
    if ((hour >= 12) && (hour < 18)) u8g2.print("こんにちは");		// day
    if ((hour >= 18) || (hour < 6)) u8g2.print("こんばんは");		  // night

    if (hour > 12) {
      hour-=12;
      PM=1;
    }

    u8g2.setCursor(hText, 30);
    u8g2.print("いまは");

    u8g2.setCursor(hText, 45);
    u8g2.setFont(u8g2_font_6x12_mn);
    if (hour <= 12) {
    u8g2.print(hour);
    if (blink == 0) u8g2.print(":");
    if (blink == 1) u8g2.print(" ");
    if (minutes < 10) { u8g2.print("0"); } // Add a leading zero if under 10 minutes
    u8g2.print(minutes);
    }
    else u8g2.print("??:??");

    u8g2.setFont(u8g2_font_b10_t_japanese1);
    if (PM == 1) u8g2.print("ごご");
    if (PM == 0) u8g2.print("ごぜん");
    u8g2.setCursor(hText, 60);
    u8g2.print("です");
  } while ( u8g2.nextPage() );

  previousMillis = millis();
}
}
